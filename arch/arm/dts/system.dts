/*
 * CAUTION: This file is automatically generated by Xilinx.
 * Version:  
 * Today is: Sat Feb  2 14:21:30 2019
 */


&axi_ethernet_sfp {
	local-mac-address = [00 0a 35 00 00 00];
};
&gem0 {
	local-mac-address = [00 0a 35 00 00 02];
};
